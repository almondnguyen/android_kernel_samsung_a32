/*
 * Generated by Samsung
 * If these files should be changed, then please make a sync with MTK
*/

#include "../../mediatek/k6853v1_64_titan/gpio04_usa.dtsi"
#include "mt6853-a32x_common.dtsi"
#include "mt6853-a32x_camera_03.dtsi"
#include "mt6853-a32x_gripsensor_00.dtsi"
#include "mt6853_input_a32x_05.dtsi"
#include "display_lcd_a32xu_common.dtsi"
/*End of this file, DO NOT ADD ANYTHING HERE*/
